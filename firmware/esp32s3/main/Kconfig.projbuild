## firmware/esp32s3/main/Kconfig.projbuild
```kconfig
menu "Ecoacoustics Network"

config ECO_WIFI_SSID
    string "Wi-Fi SSID"
    default ""

config ECO_WIFI_PASSWORD
    string "Wi-Fi password"
    default ""

config ECO_MQTT_PASSWORD
    string "EMQX MQTT password"
    default ""

endmenu
```

## firmware/esp32s3/sdkconfig.defaults
```kconfig
CONFIG_IDF_TARGET="esp32s3"
CONFIG_ESPTOOLPY_FLASHSIZE_16MB=y
CONFIG_PARTITION_TABLE_CUSTOM=y
CONFIG_PARTITION_TABLE_CUSTOM_FILENAME="partitions.csv"
CONFIG_SPIRAM=y
CONFIG_SPIRAM_MODE_OCT=y
CONFIG_SPIRAM_SPEED_80M=y
CONFIG_SPIRAM_USE_CAPS_ALLOC=y
CONFIG_MBEDTLS_EXTERNAL_MEM_ALLOC=y
CONFIG_ESP_DEFAULT_CPU_FREQ_MHZ_240=y
CONFIG_ESP_DEFAULT_CPU_FREQ_MHZ=240
CONFIG_ESP_TASK_WDT_TIMEOUT_S=30
```
