/*
 * tinyCLAP Log-Mel frontend: 44.1 kHz, 6 s, 1024-point periodic Hann FFT,
 * hop 320, centered reflect padding, Slaney Mel (64 bands, 50-14000 Hz).
 * Mel filters are generated by model/package_firmware.py.
 */
#include "feature.h"

#include <math.h>
#include <stdbool.h>
#include "esp_dsp.h"
#include "esp_log.h"

#define FFT_BINS (ECO_FFT_LENGTH / 2 + 1)
#define LOG_FLOOR 1e-10f
#define PI_F 3.14159265358979323846f

static const char *TAG = "eco_features";

extern const uint8_t mel_start[] asm("_binary_tinyclap_mel_filters_bin_start");
extern const uint8_t mel_end[]   asm("_binary_tinyclap_mel_filters_bin_end");

static const float *mel_weights = NULL;   // [64, 513], stored in Flash
static float hann[ECO_FFT_LENGTH];
static __attribute__((aligned(16))) float fft[2 * ECO_FFT_LENGTH];
static float power[FFT_BINS];
static bool initialized = false;

static int reflect_index(int index)
{
    // The only out-of-bounds distances are <= 512 for this configuration.
    if (index < 0) index = -index;
    if (index >= ECO_SEGMENT_SAMPLES) {
        index = 2 * ECO_SEGMENT_SAMPLES - 2 - index;
    }
    return index;
}

esp_err_t eco_features_init(void)
{
    const size_t expected = sizeof(float) * ECO_MEL_BANDS * FFT_BINS;
    const size_t actual = (size_t)(mel_end - mel_start);
    if (actual != expected) {
        ESP_LOGE(TAG, "Invalid mel matrix size: %u, expected %u",
                 (unsigned)actual, (unsigned)expected);
        return ESP_ERR_INVALID_SIZE;
    }
    if (((uintptr_t)mel_start % _Alignof(float)) != 0) {
        ESP_LOGE(TAG, "Mel matrix is unaligned");
        return ESP_ERR_INVALID_STATE;
    }
    mel_weights = (const float *)mel_start;
    for (size_t i = 0; i < ECO_FFT_LENGTH; ++i) {
        hann[i] = 0.5f - 0.5f * cosf(2.0f * PI_F * (float)i /
                                     (float)ECO_FFT_LENGTH);
    }
    esp_err_t err = dsps_fft2r_init_fc32(NULL, ECO_FFT_LENGTH);
    if (err == ESP_OK) {
        initialized = true;
        ESP_LOGI(TAG, "Frontend ready | %d Hz | 827x64 | Slaney mel | dB",
                 ECO_SAMPLE_RATE);
    }
    return err;
}

esp_err_t eco_features_compute(const int16_t *pcm, size_t samples,
                               eco_features_t *output)
{
    if (!initialized || pcm == NULL || output == NULL) {
        return ESP_ERR_INVALID_STATE;
    }
    if (samples != ECO_SEGMENT_SAMPLES) return ESP_ERR_INVALID_SIZE;

    for (size_t frame = 0; frame < ECO_FRAMES_PER_SEGMENT; ++frame) {
        const int center = (int)(frame * ECO_HOP_LENGTH);
        for (int i = 0; i < ECO_FFT_LENGTH; ++i) {
            const int pos = reflect_index(center + i - ECO_FFT_LENGTH / 2);
            fft[2 * i] = ((float)pcm[pos] / 32768.0f) * hann[i];
            fft[2 * i + 1] = 0.0f;
        }
        esp_err_t err = dsps_fft2r_fc32(fft, ECO_FFT_LENGTH);
        if (err != ESP_OK) return err;
        err = dsps_bit_rev_fc32(fft, ECO_FFT_LENGTH);
        if (err != ESP_OK) return err;

        for (size_t k = 0; k < FFT_BINS; ++k) {
            const float re = fft[2 * k];
            const float im = fft[2 * k + 1];
            // torchlibrosa does not normalize the spectrum by FFT size.
            power[k] = re * re + im * im;
        }
        for (size_t m = 0; m < ECO_MEL_BANDS; ++m) {
            const float *weights = mel_weights + m * FFT_BINS;
            float energy = 0.0f;
            for (size_t k = 0; k < FFT_BINS; ++k) {
                energy += power[k] * weights[k];
            }
            output->logmel[frame][m] = 10.0f * log10f(fmaxf(energy, LOG_FLOOR));
        }
    }
    return ESP_OK;
}
